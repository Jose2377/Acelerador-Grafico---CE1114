## Linux/br2-external/Config.in
```kconfig
source "$BR2_EXTERNAL_DE1SOC_PATH/package/gpu2d-driver/Config.in"
source "$BR2_EXTERNAL_DE1SOC_PATH/package/gpu2d-servicio/Config.in"
```

## Linux/br2-external/configs/de1soc_defconfig
```kconfig
# --- Arquitectura: Cyclone V HPS (2x Cortex-A9) ---
BR2_arm=y
BR2_cortex_a9=y
BR2_ARM_ENABLE_NEON=y
BR2_ARM_ENABLE_VFP=y
BR2_ARM_FPU_NEON=y

# --- Acelerar la compilación ---
# Toolchain precompilada de Bootlin (evita compilar GCC: ahorra ~1 h)
BR2_TOOLCHAIN_EXTERNAL=y
BR2_TOOLCHAIN_EXTERNAL_BOOTLIN=y
BR2_TOOLCHAIN_EXTERNAL_BOOTLIN_ARMV7_EABIHF_GLIBC_STABLE=y
BR2_CCACHE=y
BR2_CCACHE_DIR="$(HOME)/.buildroot-ccache"
BR2_DL_DIR="$(HOME)/de1soc/dl"

# --- Sistema ---
BR2_TARGET_GENERIC_HOSTNAME="de1soc"
BR2_TARGET_GENERIC_ISSUE="DE1-SoC - Unidad de aceleracion grafica 2D"
BR2_TARGET_GENERIC_ROOT_PASSWD="de1soc"
BR2_TARGET_GENERIC_GETTY_PORT="ttyS0"
BR2_TARGET_GENERIC_GETTY_BAUDRATE_115200=y
BR2_ROOTFS_DEVICE_CREATION_DYNAMIC_MDEV=y
BR2_ROOTFS_OVERLAY="$(BR2_EXTERNAL_DE1SOC_PATH)/board/de1soc/rootfs-overlay"
BR2_ROOTFS_POST_IMAGE_SCRIPT="$(BR2_EXTERNAL_DE1SOC_PATH)/board/de1soc/post-image.sh"

# --- Kernel: Linux 6.12 LTS mainline, socfpga_defconfig + fragmento ---
BR2_LINUX_KERNEL=y
BR2_LINUX_KERNEL_CUSTOM_VERSION=y
BR2_LINUX_KERNEL_CUSTOM_VERSION_VALUE="6.12.91"
BR2_LINUX_KERNEL_DEFCONFIG="socfpga"
BR2_LINUX_KERNEL_CONFIG_FRAGMENT_FILES="$(BR2_EXTERNAL_DE1SOC_PATH)/board/de1soc/linux.fragment"
BR2_LINUX_KERNEL_ZIMAGE=y
BR2_LINUX_KERNEL_DTS_SUPPORT=y
BR2_LINUX_KERNEL_INTREE_DTS_NAME="intel/socfpga/socfpga_cyclone5_de1_soc"
BR2_LINUX_KERNEL_INSTALL_TARGET=y

# --- Paquetes en la placa ---
BR2_PACKAGE_DROPBEAR=y
BR2_PACKAGE_GPU2D_DRIVER=y
BR2_PACKAGE_GPU2D_SERVICIO=y

# --- Sistema de archivos raíz ---
BR2_TARGET_ROOTFS_EXT2=y
BR2_TARGET_ROOTFS_EXT2_4=y
BR2_TARGET_ROOTFS_EXT2_SIZE="256M"
# BR2_TARGET_ROOTFS_TAR is not set

# --- U-Boot (SPL = preloader) ---
BR2_TARGET_UBOOT=y
BR2_TARGET_UBOOT_BUILD_SYSTEM_KCONFIG=y
BR2_TARGET_UBOOT_CUSTOM_VERSION=y
BR2_TARGET_UBOOT_CUSTOM_VERSION_VALUE="2026.01"
BR2_TARGET_UBOOT_BOARD_DEFCONFIG="socfpga_de1_soc"
BR2_TARGET_UBOOT_CONFIG_FRAGMENT_FILES="$(BR2_EXTERNAL_DE1SOC_PATH)/board/de1soc/uboot.fragment"
BR2_TARGET_UBOOT_NEEDS_DTC=y
BR2_TARGET_UBOOT_NEEDS_OPENSSL=y
BR2_TARGET_UBOOT_NEEDS_GNUTLS=y
BR2_TARGET_UBOOT_NEEDS_UTIL_LINUX=y
# BR2_TARGET_UBOOT_FORMAT_BIN is not set
BR2_TARGET_UBOOT_FORMAT_CUSTOM=y
BR2_TARGET_UBOOT_FORMAT_CUSTOM_NAME="u-boot-with-spl.sfp u-boot.img"

# --- Herramientas del host para la imagen de la SD ---
BR2_PACKAGE_HOST_UBOOT_TOOLS=y
BR2_PACKAGE_HOST_UBOOT_TOOLS_BOOT_SCRIPT=y
BR2_PACKAGE_HOST_UBOOT_TOOLS_BOOT_SCRIPT_SOURCE="$(BR2_EXTERNAL_DE1SOC_PATH)/board/de1soc/boot.cmd"
BR2_PACKAGE_HOST_DOSFSTOOLS=y
BR2_PACKAGE_HOST_GENIMAGE=y
BR2_PACKAGE_HOST_MTOOLS=y
```

## Linux/br2-external/package/gpu2d-driver/Config.in
```kconfig
config BR2_PACKAGE_GPU2D_DRIVER
	bool "gpu2d-driver"
	depends on BR2_LINUX_KERNEL
	help
	  Driver de kernel del puente ligero HPS-FPGA para la unidad
	  gráfica 2D. Fuente local: ejemplos/driver (cambiable con
	  GPU2D_DRIVER_OVERRIDE_SRCDIR en local.mk).
```

## Linux/br2-external/package/gpu2d-servicio/Config.in
```kconfig
config BR2_PACKAGE_GPU2D_SERVICIO
	bool "gpu2d-servicio"
	help
	  Servicio de espacio de usuario del HPS (TCP -> /dev/gpu2d).
	  Fuente local: ejemplos/servicio.
```
